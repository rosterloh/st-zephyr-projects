## CMakeLists.txt
```
cmake_minimum_required(VERSION 3.13.1)

find_package(Zephyr REQUIRED HINTS $ENV{ZEPHYR_BASE})
project(mqtt_sensor VERSION 1.0.0)
target_compile_definitions(app PRIVATE
  PROJECT_NAME=${PROJECT_NAME}
  FW_VERSION_MAJOR=${CMAKE_PROJECT_VERSION_MAJOR}
  FW_VERSION_MINOR=${CMAKE_PROJECT_VERSION_MINOR}
  FW_VERSION_PATCH=${CMAKE_PROJECT_VERSION_PATCH}
)

target_sources(app PRIVATE src/main.c)
zephyr_include_directories(src)
```

## Kconfig
```
menu "Zephyr Kernel"
source "Kconfig.zephyr"
endmenu

module = MQTT_SENSOR
module-str = MQTT Sensor
source "${ZEPHYR_BASE}/subsys/logging/Kconfig.template.log_config"
```

## prj.conf
```kconfig
CONFIG_REBOOT=y

CONFIG_NETWORKING=y
CONFIG_NET_IPV4=y
CONFIG_NET_IPV6=n
CONFIG_NET_TCP=y
CONFIG_NET_SHELL=y
CONFIG_NET_L2_WIFI_SHELL=y
CONFIG_WIFI=y
```

## src/main.c
```c
#include <zephyr.h>
#include <errno.h>

void main(void)
{

}
```
