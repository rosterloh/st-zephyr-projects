## Kconfig.projects
```kconfig
menu "ST Zephyr Projects"

#rsource "subsys/Kconfig"
#rsource "lib/Kconfig"
#rsource "drivers/Kconfig"
#rsource "ext/Kconfig"
#rsource "tests/Kconfig"

endmenu
```

## boards/arm/stm32f411_black_pill/Kconfig.board
```kconfig
config BOARD_STM32F411_BLACK_PILL
	bool "STM32F411-BLACK-PILL Development Board"
	depends on SOC_STM32F411XE
```

## boards/arm/stm32f411_black_pill/Kconfig.defconfig
```kconfig
# STM32F411-BLACK-PILL board configuration

if BOARD_STM32F411_BLACK_PILL

config BOARD
	default "stm32f411_black_pill"

config SPI_STM32_INTERRUPT
	default y
	depends on SPI

endif # BOARD_STM32F411_BLACK_PILL
```

## west.yml
```yaml
manifest:
  defaults:
    remote: zephyrproject

  remotes:
    - name: zephyrproject
      url-base: https://github.com/zephyrproject-rtos
    - name: rosterloh
      url-base: git@github.com:rosterloh

  projects:
    - name: zephyr
      revision: master
      west-commands: scripts/west-commands.yml
      import:
        name-whitelist:
          - cmsis
          - ci-tools
          - hal_st
          - hal_stm32
          - littlefs

    - name: vscode-zephyr
      remote: rosterloh
      revision: master
      path: .vscode

  self:
    path: projects
```
